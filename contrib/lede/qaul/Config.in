## contrib/lede/qaul/Config.in
```kconfig
# Qaul configuration
    menu "Configuration"
	depends on PACKAGE_qaul

    config QAUL_MINIMAL
	bool "Build minimal version of Qaul"
	default n

    endmenu
```
